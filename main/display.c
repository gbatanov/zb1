#include "settings.h"
#ifdef USE_DISPLAY
#include <stdio.h>
#include <stdlib.h>
#include <string.h>
#include "freertos/FreeRTOS.h"
#include "freertos/task.h"
#include "esp_check.h"
#include "esp_log.h"
#include "nvs_flash.h"
#include "ha/esp_zigbee_ha_standard.h"
#include "iot_button.h"
#include "driver/gpio.h" // для использования пинов на ввод/вывод
#include "ssd1306.h"
#include "zb1.h"

unsigned char zigbee_connected[] = {
    0x00, 0x00, 0x00, 0x00, 0x07, 0xE0, 0x1F, 0xF8, 0x7C, 0x3E, 0xF0, 0x0F, 0xC7, 0xE3, 0x0F, 0xF0,
    0x1C, 0x38, 0x11, 0x88, 0x07, 0xE0, 0x06, 0x60, 0x04, 0x20, 0x01, 0x80, 0x01, 0x80, 0x00, 0x00};

const unsigned char zigbee_disconnected[] = {
    0x00, 0x00, 0x01, 0x80, 0x07, 0xE0, 0x1F, 0xF8, 0x7D, 0xBE, 0xF1, 0x8F, 0xC7, 0xE3, 0x0F, 0xF0,
    0x1D, 0xB8, 0x11, 0x88, 0x07, 0xE0, 0x07, 0xE0, 0x04, 0x20, 0x01, 0x80, 0x01, 0x80, 0x00, 0x00};

const unsigned char zigbee_image[] = {
    0x07, 0xE0, 0x1F, 0xF8, 0x00, 0x0C, 0x3F, 0xC6, 0x7F, 0x82, 0xFF, 0x07, 0xFE, 0x0F, 0xFC, 0x1F,
    0xF8, 0x3F, 0xF0, 0x7F, 0xE0, 0xFF, 0x41, 0xFE, 0x63, 0xF8, 0x38, 0x08, 0x1F, 0xF8, 0x07, 0xE0};

const unsigned char zigbee[] = {
    0x00, 0x00, 0x00, 0x00, 0x00, 0x00, 0x00, 0x00, 0x00, 0x00, 0x00, 0x00, 0x00, 0x00, 0x00, 0x00,
    0x00, 0x00, 0x00, 0x00, 0x00, 0x00, 0x00, 0x00, 0x00, 0x00, 0x00, 0x00, 0x00, 0x00, 0x00, 0x00,
    0x00, 0x1F, 0xF8, 0x00, 0x00, 0x00, 0x00, 0x00, 0x00, 0x00, 0x00, 0x00, 0x00, 0x00, 0x00, 0x00,
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    0x00, 0x00, 0x00, 0x00, 0x00, 0x00, 0x00, 0x00, 0x00, 0x00, 0x00, 0x00, 0x00, 0x00, 0x00, 0x00};

#ifdef USE_BMP280
extern int16_t temperature;
#endif
extern int8_t luminocity;
extern bool lum_change;
extern bool motion_state;
extern bool mot_change;
extern int lcd_timeout;
extern uint8_t screen_number;
extern SSD1306_t ssd1306_dev;
extern bool connected;

// Задача вывода на диплей
void lcd_task(void *pvParameters)
{
    char line3[16] = {0};
    // Start lcd
    i2c_bus_add_ssd1306(&ssd1306_dev, I2C_NUM_0);
    ssd1306_init(&ssd1306_dev, 128, 64);
    ssd1306_clear_screen(&ssd1306_dev, false);
    ssd1306_contrast(&ssd1306_dev, 0xff);

    vTaskDelay(1500 / portTICK_PERIOD_MS);

    while (1)
    {
        // TODO: ждать, пока не изменится отображаемый параметр или через 10 секунд
        switch (screen_number)
        {
        case 0:
            // ESP_LOGI(TAG, "Screen number 0 ");
            ssd1306_display_text(&ssd1306_dev, 0, "GSB ZB1 0", strlen("GSB ZB1 0"), false);

            break;
        case 1:
            // ESP_LOGI(TAG, "Screen number 1 ");
            ssd1306_display_text(&ssd1306_dev, 0, "GSB ZB1 1", strlen("GSB ZB1 1"), false);
            // ssd1306_display_image(&ssd1306_dev, 1, 32, zigbee_connected, 16);

            break;
        case 2:
            // ESP_LOGI(TAG, "Screen number 2 ");
            ssd1306_display_text(&ssd1306_dev, 0, "GSB ZB1 2", strlen("GSB ZB1 2"), false);
            break;
        default:
            // ESP_LOGW(TAG, "Default screen --------");
            ssd1306_display_text(&ssd1306_dev, 3, "Default screen", strlen("Default screen"), true);
            break;
        }

        bool reverse = false;
        if (connected)
        {
            ssd1306_clear_line(&ssd1306_dev, 3, false);
            strcpy(line3, "Connected");
        }
        else
        {
            strcpy(line3, "Not connected");
            reverse = true;
        }
        ssd1306_display_text(&ssd1306_dev, 3, line3, strlen(line3), reverse);

#ifdef USE_BMP280
        if (temperature > 0)
        {
            char temp_data_str[16] = {0};
            sprintf(temp_data_str, "Temp: %.1f", (float)temperature / 100);

            ssd1306_display_text(&ssd1306_dev, 4, temp_data_str, strlen(temp_data_str), false);
        }
#endif
        if (lum_change)
        {
            if (luminocity == 0)
                ssd1306_display_text(&ssd1306_dev, 6, "Light", 5, false);
            else if (luminocity == 1)
                ssd1306_display_text(&ssd1306_dev, 6, "Dark ", 5, false);
            lum_change = false;
        }
        if (mot_change)
        {
            if (motion_state)
                ssd1306_display_text(&ssd1306_dev, 5, "Motion", strlen("No motion"), false);
            else
                ssd1306_display_text(&ssd1306_dev, 5, "No motion   ", strlen("No motion"), false);
            mot_change = false;
        }
        lcd_timeout = lcd_timeout - 1;
        if (lcd_timeout <= 0)
        {
            screen_number = 2;
        }
        else
        {
            lcd_timeout = lcd_timeout - 1;
        }

        vTaskDelay(3000 / portTICK_PERIOD_MS);
    }
}
#endif
