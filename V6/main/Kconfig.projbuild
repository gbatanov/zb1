## V6/main/Kconfig.projbuild
```kconfig
menu "I2C Settings"
    config I2C_MASTER_FREQ_HZ
        int "I2C_MASTER_FREQ_HZ"
        default 400000
        help
            I2C_MASTER_FREQ_HZ.

    config SCL_GPIO
                int "I2C SCL pin"
                default 4
                help
                    I2C SCL pin.
    
    config SDA_GPIO
            int "I2C SDA pin"
            default 3
            help
                I2C SCL pin.

endmenu
```

## components/paj7620/Kconfig
```kconfig
menu "PAJ7620 Gesture Sensor"
        config GESTURE_SENSOR_ADDR
            hex "Gesture Sensor I2C Address"
            default 0x73
            help
                I2C address of the Gesture Sensor.

        config GESTURE_DURATION
            int "Gesture Duration (ms)"
            default 500
            help
                The amount of time it takes to perform a gesture, in milliseconds.

endmenu
```
